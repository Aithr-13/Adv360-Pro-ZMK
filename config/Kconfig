## config/behaviors/Kconfig
```kconfig
# Kconfig for Custom Behaviors

config ZMK_BEHAVIOR_ALT_TAB
    default y
    bool "Alt-Tab Custom Behavior"
    depends on ZMK_BEHAVIORS
    help
      Enables the custom Alt-Tab behavior which holds Alt and sends Tab on taps.
```

## config/boards/arm/adv360/Kconfig
```kconfig
# SPDX-License-Identifier: MIT
config BOARD_ENABLE_DCDC
    bool "Enable DCDC mode"
    select SOC_DCDC_NRF52X
    default y
    depends on BOARD_ADV360_LEFT || BOARD_ADV360_RIGHT

config ZMK_BEHAVIOR_ALT_TAB
    default y
    bool "Alt-Tab Custom Behavior"
    depends on ZMK_BEHAVIORS
    help
      Enables the custom Alt-Tab behavior which holds Alt and sends Tab on taps.
```

## config/boards/arm/adv360/Kconfig.board
```kconfig
#
# Copyright (c) 2022 The ZMK Contributors
# SPDX-License-Identifier: MIT
#

config BOARD_ADV360_LEFT
    bool "adv360_left"
    depends on SOC_NRF52840_QIAA

config BOARD_ADV360_RIGHT
    bool "adv360_right"
    depends on SOC_NRF52840_QIAA
# Inside config/boards/arm/adv360/Kconfig.board (or Kconfig)

# Custom behavior
config ZMK_BEHAVIOR_ALT_TAB
    bool "Enable custom Alt-Tab behavior"
    default y # Enable by default for this board
    help
      Enables the custom C behavior for Alt-Tab functionality
      with timed release.
```
